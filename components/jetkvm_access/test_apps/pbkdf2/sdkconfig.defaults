## components/jetkvm_access/test_apps/pbkdf2/sdkconfig.defaults
```kconfig
CONFIG_ESP_DEFAULT_CPU_FREQ_MHZ_400=y
CONFIG_FREERTOS_HZ=100
CONFIG_ESP_MAIN_TASK_STACK_SIZE=8192
CONFIG_ESP_CONSOLE_USB_SERIAL_JTAG=y
CONFIG_ESP_CONSOLE_SECONDARY_NONE=y
CONFIG_ESPTOOLPY_FLASHMODE_DIO=y
CONFIG_ESPTOOLPY_FLASHSIZE_16MB=y
CONFIG_COMPILER_OPTIMIZATION_PERF=y
CONFIG_MBEDTLS_HARDWARE_SHA=y
```

## components/jetkvm_identity/Kconfig
```kconfig
menu "JetKVM identity"

config JETKVM_BENCH_CUSTOM_MAC
    bool "Bench only: pretend that eFuse holds the factory MAC 02:4a:4b:00:00:01"
    default n
    help
        Report the locally administered address 02:4a:4b:00:00:01 as the
        factory MAC of eFuse USER_DATA.MAC_CUSTOM, so that a bench Mini without
        that field tests the MAC address setting. Bench builds only: the
        release check (tools/release_config.py) refuses a build with it.

endmenu
```

## components/jetkvm_os_services/Kconfig
```kconfig
menu "JetKVM OS Services"

config JETKVM_OS_SERVICES
    bool "IP-KVM OS Services over USB"
    default y
    help
        Adds the IP-KVM OS Services vendor interface to the target USB
        device, so the OS Services sender on the target can share its
        clipboard, a shell, files and its screen with the KVM.

config JETKVM_OS_SERVICES_USB_BUFFER_KIB
    int "Size of each OS Services USB transfer buffer (KiB)"
    depends on JETKVM_OS_SERVICES
    range 2 32
    default 16
    help
        Two OUT buffers and one IN buffer of this size live in DMA-capable
        PSRAM, so they take no internal RAM from WebRTC and the Wi-Fi
        driver. Larger buffers move more data per USB transfer: against
        4 KiB, 16 KiB cut the time the sender takes to write a 1080p or
        1440p service video frame by about a third.

endmenu
```

## components/jetkvm_screen/Kconfig
```kconfig
menu "JetKVM screen"

choice JETKVM_SCREEN_ROTATION
    prompt "Display hardware rotation"
    default JETKVM_SCREEN_ROTATION_0
    help
        Rotate the ST7789 display in hardware. This changes the controller's
        MADCTL bits and GRAM window; it does not rotate pixels in software.

config JETKVM_SCREEN_ROTATION_0
    bool "0 degrees"

config JETKVM_SCREEN_ROTATION_90
    bool "90 degrees clockwise"

config JETKVM_SCREEN_ROTATION_180
    bool "180 degrees"

config JETKVM_SCREEN_ROTATION_270
    bool "270 degrees clockwise"

endchoice

config JETKVM_SCREEN_BUTTONS
    bool "Drive the local UI with the SW2 and SW3 push buttons"
    default n
    help
        The two push buttons beside the panel navigate the local display.
        The upper button (SW3) goes back; the lower button (SW2) steps down
        or scrolls on a tap and accepts on a hold. The confirmation screens
        keep their hold countdown on the lower button. While this is enabled
        the video component leaves SW3 alone, so the button does not toggle
        the HDMI preview mode.

endmenu
```

## components/jetkvm_usb_debugging/Kconfig
```kconfig
menu "JetKVM USB debugging"

config JETKVM_USB_DEBUGGING_DEFAULT_ON
    bool "USB debugging is on until the setting is changed (bench builds only)"
    default n
    help
        Without a stored USB debugging setting, keep the USB Serial/JTAG port
        on the Power/EXT connector connected. Bench builds set this option
        (the Dockerfile, with the USB_DEBUGGING build argument that
        tools/combined_load/runner/build.mjs gives), because the bench
        flashes and reads the console over that port. A release leaves it
        off: the port is then off until a user turns USB debugging on, and
        tools/release_config.py refuses a release build with this option.

endmenu
```

## components/jetkvm_virtual_media_http/Kconfig
```kconfig
menu "JetKVM virtual-media HTTP"

config JETKVM_VIRTUAL_MEDIA_HTTP_LOCAL_CONTROL
    bool "Enable local REST storage control"
    default y
    help
        Expose the small local REST surface used to start and verify TF image
        uploads without first creating a WebRTC peer. These routes require the
        same authentication as the rest of the device API. Disable this option
        in a build that must not expose local storage mutation over HTTP.

config JETKVM_VIRTUAL_MEDIA_HTTP_DIAGNOSTIC_DISCARD
    bool "Enable HTTP receive-only discard diagnostic"
    default n
    depends on JETKVM_VIRTUAL_MEDIA_HTTP_LOCAL_CONTROL
    help
        Expose POST /storage/diagnostics/http-discard to measure the HTTP/TCP
        receive ceiling without creating an upload or calling the TF/FatFs
        path. Requests must also carry the explicit diagnostic confirmation
        header and are bounded to 16..256 MiB. This endpoint requires the same
        authentication as the rest of the device API and can occupy the
        synchronous HTTP server while a test is running; leave it disabled in
        production.

endmenu
```

## components/webrtc_transport/Kconfig
```kconfig
menu "Local WebRTC transport"

config WEBRTC_TRANSPORT_HTTPS
    bool "HTTPS listener and TLS settings"
    default n
    help
        Start the HTTPS listener when the TLS setting is enabled and serve the
        getTLSState/setTLSState RPCs. Off by default on the Mini: with the hot
        video and transport paths placed in internal RAM, the HTTPS listener
        (10 KiB task stack plus sockets and TLS context) leaves too little
        internal RAM for peer setup while a browser holds its connections.
        The device capabilities already report access.tls as unsupported,
        and the upstream TLS test skips when the RPCs answer "Method not
        found".

config WEBRTC_TRANSPORT_WEBSOCKET
    bool
    default y
    select HTTPD_WS_SUPPORT
    select HTTPD_WS_PRE_HANDSHAKE_CB_SUPPORT
    select HTTPD_WS_POST_HANDSHAKE_CB_SUPPORT
    help
        The device UI requires the upstream WebSocket signaling endpoint.

config WEBRTC_TRANSPORT_AGENT_RECV_TIMEOUT_MS
    int "ICE agent receive poll timeout (milliseconds)"
    range 1 1000
    default 1
    help
        Receive timeout requested by the manually driven esp_peer event loop.
        Handshakes use at least 100 ms per receive because the vendor DTLS
        adapter treats eleven empty receives as peer close. This allows
        delayed relay input. Gathering and connected peers use bounded
        non-blocking receive slices for signaling and video.

config WEBRTC_TRANSPORT_HTTP_PORT
    int "Diagnostic HTTP server port"
    range 1 65535
    default 80

config WEBRTC_TRANSPORT_TASK_STACK
    int "Peer task stack (bytes)"
    range 12288 65536
    default 24576

config WEBRTC_TRANSPORT_TASK_PRIORITY
    int "Peer task priority"
    range 1 20
    default 6

config WEBRTC_TRANSPORT_TASK_CORE
    int "Peer task core (-1 for no affinity)"
    range -1 1
    default 1
    help
        A value of -1 lets the scheduler choose the initial CPU. On targets
        with lazy coprocessor context switching, using FPU or vector
        instructions may subsequently pin a task to its current CPU.

config WEBRTC_TRANSPORT_AU_SLOTS
    int "Preallocated Annex-B access-unit slots"
    range 2 4
    default 2
    help
        The encoder callback never waits for the network. Encoded access units
        are sent in order. When all slots are busy, the new unit is rejected;
        the sender detects the gap and requests an IDR before sending dependent
        frames again.

config WEBRTC_TRANSPORT_MAX_AU_BYTES
    int "Maximum Annex-B access-unit bytes"
    range 524288 2097152
    default 524288
    help
        This matches the bounded 512 KiB encoder output allocation.  An
        oversized access unit is rejected and counted instead of truncated.

config WEBRTC_TRANSPORT_RTP_POOL_BYTES
    int "esp_peer RTP send pool bytes"
    range 262144 4194304
    default 1048576

config WEBRTC_TRANSPORT_RTP_QUEUE_PACKETS
    int "esp_peer RTP send queue packet count"
    range 128 4096
    default 1536

config WEBRTC_TRANSPORT_DATA_CHANNEL_SEND_CACHE_BYTES
    int "DataChannel send cache bytes"
    range 1536 1048576
    default 262144
    help
        SCTP application-data cache for device-to-browser messages. Upload
        acknowledgements are small, so this direction does not need to carry
        the browser-to-device bandwidth-delay product.

config WEBRTC_TRANSPORT_DATA_CHANNEL_RECEIVE_CACHE_BYTES
    int "DataChannel receive cache bytes"
    range 262144 4194304
    default 262144
    help
        SCTP application-data cache for browser-to-device messages. SACKs
        advertise it less a 164 KiB reserve for the chunk after the
        cumulative acknowledgement (peer_sctp_receive.c). The allocation is
        served from PSRAM.

config WEBRTC_TRANSPORT_SESSION_TIMEOUT_MS
    int "Browser polling timeout (milliseconds)"
    range 5000 60000
    default 15000

config WEBRTC_TRANSPORT_RECONNECT_DELAY_MS
    int "Peer reconnect delay (milliseconds)"
    range 100 10000
    default 1000

endmenu
```
